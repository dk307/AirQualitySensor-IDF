## main/Kconfig
```kconfig
menu "Project"
    
config SHT3X_SENSOR_ENABLE
	bool "Enable Sensor SHT 3x for temperature & humidity"
	default n

config SCD30_SENSOR_ENABLE
	bool "Enable Sensor SCD30 for CO2, temperature & humidity"
	default n
	
config SCD30_SENSOR_TEMPERATURE_OFFSET
	int "Temperature offset for SCD30 in increment of 0.01C"
	default 0
	depends on SCD30_SENSOR_ENABLE

config SCD4x_SENSOR_ENABLE
	bool "Enable Sensor SCD4x for CO2, temperature & humidity"
	default n
	
config SCD4x_SENSOR_TEMPERATURE_OFFSET
	int "Temperature offset for SCD4x in increment of 0.01C"
	default 400
	depends on SCD4x_SENSOR_ENABLE

config ENABLE_SD_CARD_SUPPORT
	bool "Enable SD Card Support"
	default n
			
endmenu
```
